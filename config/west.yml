## config/west.yml
```yaml
manifest:
  remotes:
    - name: zmkfirmware 
      url-base: https://github.com/zmkfirmware
    - name: MeowCatpawkittie
      url-base: https://github.com/MeowCatpawkittie
    - name: caksoylar  # <-- new entry
      url-base: https://github.com/caksoylar  
    - name: badjeff
      url-base: https://github.com/badjeff
    - name: sekigon-gonnoc
      url-base: https://github.com/sekigon-gonnoc
  projects:
    - name: zmk
      remote: zmkfirmware
      revision: main
      import: app/west.yml
    - name: zmk-pmw3610-driver
      remote: badjeff
      revision: main
    - name: cirque-input-module
      remote: MeowCatpawkittie
      revision: main
    - name: zmk-rgbled-widget
      remote: caksoylar
      revision: main
    - name: zmk-driver-paw3222
      remote: sekigon-gonnoc
      revision: main
  self:
    path: config
```
